/** Arduino C/C++ *************************************** AboutATcommand.ino ***
 * 
 * Познакомиться с AT-командами SIM900 и с выборкой данных с помощью regexp
 * 
 * v1.0.2, 27.11.2025                                  Автор:      Труфанов В.Е.
 * Copyright © 2025 tve                                Дата создания: 26.07.2025
 *
**/

#include <Regexp.h>
// match state object
MatchState ms;
// char bufi[16] = "The  quick brown";
char bufi[16] = "The,1234brown";

#include <SoftwareSerial.h>
// Configure software serial port
SoftwareSerial SIM900(7,8); 
// Резервируем буфер для записи ответного сообщения
char answer[128]; 

void setup() 
{
  Serial.begin(9600);
  SIM900.begin(9600);
  Serial.println(" ");
  // AT - Рукопожатие с SIM900. "AT" – Это самая простая команда AT. Она также инициализирует передачу данных в бодах
  // Если это сработает, далее вы будете видеть эхо-сигнал символов AT, а затем OK, сообщающий вам, что все в порядке и SIM900 правильно вас понимает!
  // Проверяем, реагирует ли модуль, ожидаемое значение  OK
  sendCommand("AT","Проверяем, реагирует ли SIM900 на команды"); 

  // Выбираем первые 4 цифры в буфере
  Proba(bufi,"%d%d%d%d");

  // AT+COPS? – Убедится, что вы подключены к сети и получить информацию об операторе
  sendCommand("AT+COPS?","Убеждаемся в подключении к сети и получаем информацию об операторе"); 
  // AT+CSQ – Проверить "уровень сигнала" – первое значение это уровень сигнала в дБ, он должен быть выше 5. Чем выше, тем лучше, до 31.
  sendCommand("AT+CSQ","Проверяем уровень сигнала – первое значение это уровень сигнала в дБ, он должен быть выше 5. Чем выше, тем лучше, до 31."); 
  // AT+CCID – Получить номер SIM–карты, это проверка того, что SIM-карта найдена нормально, и вы можете проверить, какой номер присвоен карте
  sendCommand("AT+CCID","Получаем номер SIM–карты, это проверка того, что SIM-карта найдена нормально и какой она имеет номер"); 
  // AT+CREG? Проверить, зарегистрированы ли вы в сети. Второе число должно быть 1 или 5. 1 означает, что вы зарегистрированы в домашней сети,
  // а 5 - в роуминговой сети. Кроме этих двух цифр, вы не зарегистрированы ни в какой сети
  sendCommand("AT+CREG?","Проверяем регистрацию в сети. Второе число: 1 - регистрация в домашней сети, 5 - в роуминговой сети"); 
  // ATI – Получить название платы и её редакцию
  sendCommand("ATI","Получаем название платы и её редакцию"); 
  // AT+CBC – Получить состояние батареи lipo. Вторая цифра - это % заполнения, а третья цифра - фактическое напряжение в мВ
  sendCommand("AT+CBC"," Получаем состояние батареи. Вторая цифра - это % заполнения, а третья цифра - фактическое напряжение в мВ"); 
 
  // Выбираем первые 4 цифры в ответе
  Proba(answer,"%d%d%d%d");
  delay(1000); 
  /*
  «АТ+IPR?»   — проверяем скорость порта;
  «АТ+IFC?»   — проверяем, происходит ли контроль передачи информации;
  «АТ+GSAP»   — проверяем, на что способен модем;
  «АТ+GMM»    — запрашиваем идентификатор модема;
  «АТ+GMR»    — запрашиваем идентификатор ревизии модема;
  «АТ+GSN»    — запрашиваем IMEI устройства;
  «АТ+COPS=?» — проверяем список всех доступных сотовых операторов;
  «АТ+CPAS»   — проверяем рабочее состояние модема;
  «АТ+CCLK?»  — проверяем текущие настройки времени и даты в устройстве;
  «АТ+СМЕЕ=0,1или 2», где «0» — отключаем получение информации о возникающих ошибках в работе, «1» — просим присылать код ошибки, «2» — просим присылать описание ошибки;
  «АТ+ССLK=»     - прописываем нужную дату и время»» — устанавливаем дату и время;
  «АТ+СPIN»=ХХХХ - определяем ПИН-код для модема;
  «ATZ0 или 1»   - сбрасываем настройки модема до определенного уровня, где «0» или «1» — это профили (уровни) настроек модема;
  «AT&F»         - сбрасываем настройки до заводских;
  «AT+COPN»      - запрашиваем список всех имен операторов из памяти модуля.
  */
}
  
void loop() 
{
}

/**
 * Выполнить AT команду SIM900
**/ 
void sendCommand(const char* command, char* info) 
{
  // Показываем информацию по предстоящей команде
  Serial.print("--- ");
  Serial.println(info);
  // Отправляем команду SIM900
  SIM900.println(command);
  // Serial.flush() — функция в аппаратной платформе Arduino, которая ожидает окончания передачи исходящих данных. 
  // После вызова этой функции можно быть уверенным, что все данные отправлены, а буфер пуст. 
  // Кроме того, Serial.flush() очищает буфер приёма, сбрасывая любые входящие данные, которые ещё не были прочитаны. 
  // Это особенно полезно в ситуациях, когда входящие данные могут быть устаревшими или неактуальными. 
  // gprsShield.flush();
  // Uncomment this delay if you need to wait a while
  delay(1000);   
  ShowSerialData();
}
/**
 * Prints the serial data, and waits 1 second
**/
void ShowSerialData() 
{
  // Чистим буфер сообщения
  memset(answer,'\0',128); 
  while (SIM900.available()) 
  {
    char c = SIM900.read();
    Serial.write(c);
    strcat(answer,String(c).c_str()); 
  }
  Serial.println("");
  delay(1000);
}
/**
 * Выбрать в буфере подстроку по запросу regexp
**/ 
void Proba(char buf[],char mch[]) 
{
  // what we are searching (the target)
  ms.Target (buf);  // set its address
  Serial.println (buf);

  //char result = ms.Match ("f.x");
  //char result = ms.Match ("%s%s(%a+)( )");
  //char result = ms.Match ("%s%s(%a+)");
  //char result = ms.Match("%d%d%d%d");
  char result = ms.Match(mch);
  
  if (result > 0)
    {
    Serial.print ("Found match at: ");
    Serial.println (ms.MatchStart);        // 16 in this case     
    Serial.print ("Match length: ");
    Serial.println (ms.MatchLength);       // 3 in this case
    }
  else
    Serial.println ("No match.");


  for (int j = ms.MatchStart; j < ms.MatchStart+ms.MatchLength; j++)
  {
    Serial.write(buf[j]);
  }
  Serial.println (" ");
}

// Arduino C/C++ **************************************** AboutATcommand.ino ***
                                                                                                                                                                                                  
