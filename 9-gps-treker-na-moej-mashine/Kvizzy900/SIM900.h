/** Arduino UNO, SIM900 **************************************** VKEL_TTL.h ***
 * 
 * Обеспечить взаимодействие с SIM900 и передачу данных на сайт 
 * 
 * v1.1.4, 10.11.2025                                 Автор:      Труфанов В.Е.
 * Copyright © 2025 tve                               Дата создания: 16.10.2025
**/

#ifndef SIM900_h
#define SIM900_h
// Указываем, что данный файл нужно подключить только один раз
#pragma once  

// Подключаем список 16-символьных сообщений приложения Kvizzy900
// и функцию вывода сообщений
#include "s16_Kvizzy900.h"

_DS(AT_AT,"AT") 
//_DS(AT_CSQ,"AT+CSQ") 
_DS(AT_L,"ATL") 
_DS(AT_Contype,"AT+SAPBR=3,1,\"Contype\",\"GPRS\"") 
_DS(AT_SAPBR,"AT+SAPBR=3,1,\"APN\",\"internet.mts.ru\"") 
_DS(AT_SAPBR1,"AT+SAPBR=1,1")
_DS(AT_SAPBR0,"AT+SAPBR=0,1")
_DS(AT_HTTPINIT,"AT+HTTPINIT") 
_DS(AT_HTTPPARA,"AT+HTTPPARA=\"CID\",1") 
_DS(AT_HTTPACTION0,"AT+HTTPACTION=0") 
_DS(AT_HTTPREAD,"AT+HTTPREAD") 
_DS(AT_HTTPTERM,"AT+HTTPTERM") 

uint32_t glat,glon;               // значения координат, передаваемые на сайт 

uint32_t BdelaySIM=millis();      // начало отсчета времени до передачи на сайт 
uint32_t  delaySIM;               // истекший интервал после передачи 
uint32_t  dTimeSIM=180000;        // интервал подачи координат в мс на сайт (3 мин)          

// ****************************************************************************
// *                 Сформировать сообщения по ошибке AT-команды              *
// ****************************************************************************
void ATerrorMess(char* ATcommand, uint8_t answer) 
{
  // Выводим текст AT команды
  if (answer!=0) saymest(ATcommand);
  // Выводим сообщение об ошибке
  if (answer==1) saymess(m1_ResponsExceed);
  else if (answer==2) saymess(m1_NoReception);
  else if (answer==3) saymess(m1_NoConfirmed);
  else if (answer==4) saymess(m1_NotCompleted);
} 
// ****************************************************************************
// *               Отправить AT-командe на SIM900 и выбрать ответ             *
// ****************************************************************************
/*
Функция отправляет AT-команду в SIM900 и выбирает ответ за заданное время тайм-аута.
Возвращается ответ answer: 
  0 - "передана команда SIM900, получен подтверждающий ответ";
  1 - "ответ SIM900 превышает 150 символов";
  2 - "за время тайм-аута не начат приём ответа";
  3 - "ответ на команду не подтвержден"
  4 - "за время тайм-аута не завершён ответ"
*/
uint8_t ATcom(char* ATcommand, char* expected_answer, unsigned int timeout)
//uint8_t ATcom(char ATcommand[], char* expected_answer, unsigned int timeout)
{
  // Резервируем переменную ответа
  static uint8_t answer;                  
  // Инициируем переменные
  uint8_t i;                               // позиция в заполняемом буфере ответа GPRS(SIM900)
  answer=2;                                // "за время тайм-аута не начат приём ответа"
  unsigned long previous;                  // время начала приема ответа от GPRS
  i = 0;                                   // установили начальную позицию заполнения буфера
  delay(100);                              // сделали начальную задержку перед подачей команды
  previous = millis();                     // зафиксировали начальное время для отсчета таймаута
  // Очищаем возможно оставшийся прежний ответ от GPRS
  while (SIM900.available()>0) SIM900.read(); 
  
  // !!! В единственном случае, когда передается команда передачи 
  // данных на сайт, сама команда находится в буфере приема ответа, 
  // поэтому буфер чистится строго после отправки команды
  
  // 1 шаг: Отправляем AT-команду   
  SIM900.println(ATcommand);  
  //SIM900.println(_FS(ATcommand));  
  // 2 шаг: Чистим буфер для приема ответа
  memset(response,'\0',170);               // очистили буфер 
  
  // Циклимся, пока не выберем весь ответ за время тайм-аута
  do
  {
    // Если во входном буфере UART есть данные, считывает их 
    if (SIM900.available() != 0)
    {    
      response[i] = SIM900.read();
      i++;
      // Проверяем, не вышли ли за границу буфера
      if (i>255) {answer=1; break; }
    }
  }
  while((answer == 2) && ((millis() - previous) < timeout));
  //Serial.print("i="); Serial.println(i); 


  // При необходимости трассируем ответ на AT-команду
  if (isATTrass) saymest(response);
  if (isATTrass) saymest(ATcommand);
  // Если вышли ли за границу буфера, то возвращаем ошибку
  // "ответ SIM900 превышает 256 символов"  
  if (answer==1) goto by; 
  // Если остались в начальной позиции, то возвращаем ошибку
  // "за время тайм-аута не начат приём ответа"  
  else if (i==0) goto by;  
  // Если еще есть символы в буфере SIM900, то возвращаем ошибку
  // "за время тайм-аута не завершён ответ"
  else if (SIM900.available()!=0) {answer=4; goto by;} 
  // Проверяем, есть ли желаемый ответ в ответе модуля
  if (strstr(response, expected_answer) != NULL)    
  /* 
    Функция strstr в C++ используется для поиска первого вхождения подстроки в строке. 
    Она определена в стандартной библиотеке C, поэтому доступна и в C++.
    Параметры: response — строка, в которой выполняется поиск; expected_answer — подстрока для поиска в строке response.
    Возвращаемое значение: указатель на первое вхождение подстроки в строке; нулевой указатель (nullptr), если подстрока не найдена.
    Важно: функция чувствительна к регистру — например, поиск по «hello» не соответствует «Hello». 
    Синтаксис: char* strstr(const char* str1, const char* str2).
    Чтобы использовать strstr, в начале кода нужно включить заголовочный файл <cstring> или <string.h> — 
    это гарантирует, что компилятор распознаёт функцию.
  */ 
  {
    // "передана команда SIM900, получен подтверждающий ответ"
    answer = 0;
  }
  else 
  {
    // "ответ SIM900 на команду не подтвержден"
    answer = 3;
  }
  // Завершаем работу функции и возвращаем ответ
  by:
  ATerrorMess(ATcommand,answer);
  // Serial.print("answer="); Serial.println(answer); 
  return answer;
}

//uint8_t AT_(const char ATcommand[],unsigned int timeout)
uint8_t AT_(unsigned int timeout)
{
  // Резервируем переменную результата функции
  static uint8_t answer;                  
  // Инициируем переменные
  uint8_t i;                               // позиция в заполняемом буфере ответа GPRS(SIM900)
  answer=2;                                // "за время тайм-аута не начат приём ответа"
  unsigned long previous;                  // время начала приема ответа от GPRS
  delay(100);                              // сделали начальную задержку перед подачей команды
  previous = millis();                     // зафиксировали начальное время для отсчета таймаута
  // Очищаем возможно оставшийся прежний ответ от GPRS
  while (SIM900.available()>0) SIM900.read(); 
  
  // 1 шаг: Отправляем AT-команду   
  //SIM900.println(ATcommand);  
  //Serial.print("sizeof(response)="); Serial.println(sizeof(response));
  //Serial.print("response*"); Serial.print(response); Serial.println("*"); 
  SIM900.println(response);  
  // 2 шаг: Чистим буфер для приема ответа
  memset(response,'\0',170);               // очистили буфер 
  
  // Циклимся, пока не выберем весь ответ за время тайм-аута
  i = 0;                                   // установили начальную позицию заполнения буфера
  do
  {
    // Если во входном буфере UART есть данные, считывает их 
    if (SIM900.available() != 0)
    {    
      response[i] = SIM900.read();
      i++;
      // Проверяем, не вышли ли за границу буфера
      if (i>169) {answer=1; break; }
    }
  }
  while((answer == 2) && ((millis() - previous) < timeout));
  // При необходимости трассируем ответ на AT-команду
  //Serial.println("==="); 
  if (isATTrass) saymest(response);
  //Serial.println("==="); 
  // Если вышли ли за границу буфера, то возвращаем ошибку
  // "ответ SIM900 превышает 256 символов"  
  if (answer==1) goto by; 
  // Если остались в начальной позиции, то возвращаем ошибку
  // "за время тайм-аута не начат приём ответа"  
  else if (i==0) goto by;  
  // Если еще есть символы в буфере SIM900, то возвращаем ошибку
  // "за время тайм-аута не завершён ответ"
  else if (SIM900.available()!=0) {answer=4; goto by;} 
  // Проверяем, есть ли желаемый ответ в ответе модуля
  //if (strstr(response, expected_answer) != NULL)    
  if (strstr(response,"OK") != NULL)    
  /* 
    Функция strstr в C++ используется для поиска первого вхождения подстроки в строке. 
    Она определена в стандартной библиотеке C, поэтому доступна и в C++.
    Параметры: response — строка, в которой выполняется поиск; expected_answer — подстрока для поиска в строке response.
    Возвращаемое значение: указатель на первое вхождение подстроки в строке; нулевой указатель (nullptr), если подстрока не найдена.
    Важно: функция чувствительна к регистру — например, поиск по «hello» не соответствует «Hello». 
    Синтаксис: char* strstr(const char* str1, const char* str2).
    Чтобы использовать strstr, в начале кода нужно включить заголовочный файл <cstring> или <string.h> — 
    это гарантирует, что компилятор распознаёт функцию.
  */ 
  {
    // "передана команда SIM900, получен подтверждающий ответ"
    answer = 0;
  }
  else 
  {
    // "ответ SIM900 на команду не подтвержден"
    answer = 3;
  }
  // Завершаем работу функции и возвращаем ответ
  by:
  ATerrorMess(response,answer);
  // Serial.print("answer="); Serial.println(answer); 
  return answer;
}

uint8_t AT_com(const char ATcommand[],unsigned int timeout=500)
{
  // При отправке AT-команды используется один и тот же буфер для отправки команды и 
  // приёма ответа, поэтому буфер готовится (чистится) дважды
  memset(response,'\0',170);      // очистили буфер 
  strcpy_P(response,ATcommand);   // перекинули в буфер команду из программной памяти    
  return AT_(timeout);  
}

uint8_t AT_RAM(const char ATcommand[],unsigned int timeout=500)
{
  // При отправке AT-команды используется один и тот же буфер для отправки команды и 
  // приёма ответа, поэтому буфер готовится (чистится) дважды
  memset(response,'\0',170);      // очистили буфер 
  strcpy(response,ATcommand);     // перекинули в буфер команду из программной памяти    
  return AT_(timeout);  
}


// ****************************************************************************
// *  Включить/выключить (программный триггер) SIM900 через вывод D9 Arduino  *
// *     (В качестве синхронизации включения/выключения требуется импульс     *
// *    длительностью > 1 сек,  а для стабилизации синхронизации требуется    *
// *                          задержка > 3,2 сек)                             *
// ****************************************************************************
/**
 * Включение/выключение чипа SIM900.
 * Даже при включении питания платы SIM900 необходимо включить чип SIM900, чтобы он заработал.
 * Согласно техническому описанию, для включения/выключения питания микросхемы необходимо 
 * нажимать контакт PWRKEY в течение как минимум 1 секунды. Это можно сделать двумя способами:
 * - Hardware Trigger. Плата оснащена прямоугольным тактильным переключателем, 
 * расположенным рядом со светодиодным индикатором PWR. Для включения/выключения экрана 
 * необходимо нажимать на этот переключатель в течение примерно 2 секунд.
 * - Software trigger. Вместо того чтобы каждый раз нажимать клавишу PWR вручную, 
 * вы можете программно включать/выключать SIM900. 
 * 
 * Для этого, сначала вам нужно припаять перемычку SMD между контактами R13 на 
 * плате. Далее вам нужно подключить вывод D9 платы к выводу D9 на Arduino.
**/
void SIM900powerUpOrDown()
{
  pinMode(9, OUTPUT);
  digitalWrite(9,LOW);
  delay(1000);
  digitalWrite(9,HIGH);
  delay(2000);
  digitalWrite(9,LOW);
  delay(3000);
}
// ****************************************************************************
// *          Выполнить передачу последних принятых координат на сайт         *
// ****************************************************************************
// 2025-11-04 вид запроса, введенный вручную 
// http://probatv.ru/State/?cycle=7&num=5&ctrl=204&sjson={"trkpt":{"lat":52518611,"lon":13376111,"color":"yellow"}}
// 2025-11-04 вид запроса, считанный из URL сайта в Edge и Google Chrome
// http://probatv.ru/State/?cycle=7&num=5&ctrl=204&sjson={%22trkpt%22:{%22lat%22:52518611,%22lon%22:13376111,%22color%22:%22yellow%22}}
// 2025-11-04 вид запроса, считанный из URL сайта в Yandex
// http://probatv.ru/State/?cycle=7&num=5&ctrl=204&sjson=%7B%22trkpt%22:%7B%22lat%22:52518611,%22lon%22:13376111,%22color%22:%22yellow%22%7D%7D
// 2 репозитария, которые могут пригодиться в будущем
// https://github.com/lbussy/LCBUrl
// https://github.com/plageoj/urlencode
const char str0[]="AT+HTTPPARA=\"URL\",\"http://probatv.ru/State/?cycle=";
const char str1[]="&num=5&ctrl=204&sjson={%22trkpt%22:{%22lat%22:";
const char str2[]=",%22lon%22:";
const char str3[]=",%22color%22:%22blue%22}}\"";
bool send_coords_at(uint32_t glat, uint32_t glon, uint32_t gcik)
{
  // Проверяем "уровень сигнала" – первое значение это уровень сигнала в дБ, он должен быть выше 5. Чем выше, тем лучше, до 31.
  // if (ATcom("AT+CSQ","OK",500)!=0) return false;;
  // Закрываем все соединения TCP/UDP, которые могли быть открыты на модуле. 
  // Использование этой команды может быть полезно, например, при переустановке 
  // соединения или для освобождения ресурсов, занятых предыдущими соединениями. 
  // if (ATcom("AT+CIPSHUT","OK",500)!=0) return false;
  // Открываем контекст GPRS и устанавливаем GPRS-соединение
  //     if (ATcom("AT+SAPBR=3,1,\"Contype\",\"GPRS\"","OK",500)!=0) return false;
  if (AT_com(AT_Contype)!=0) return false;
  // Определяем имя точки доступа Access Point Name (APN) — как “internet.mts.ru”.
  //   if (ATcom("AT+SAPBR=3,1,\"APN\",\"internet.mts.ru\"","OK",500)!=0) return false;
  if (AT_com(AT_SAPBR)!=0) return false;
  // Устанавливаем соединение для профиля с идентификатором 1.
  // Когда соединение будет установлено, можно получить параметры сеанса с помощью 
  // команды AT+SAPBR=2,1. После установления соединения команда вернет адрес 
  // IP из внутренней сети мобильного провайдера   
  //  if (ATcom("AT+SAPBR=1,1","OK",2000)!=0) 
  if (AT_com(AT_SAPBR1,2000)!=0) 
  {
    // Перезакрываем носитель контекста GPRS (сессию), если он был оставлен открытым
    // (команда AT+SAPBR=0,1 используется для закрытия сессии и соединения TCP/IP, 
    // чтобы не расходовать ресурсы мобильного провайдера. 
    //        ATcom("AT+SAPBR=0,1","OK",1500);
    AT_com(AT_SAPBR0,1500);
    if (AT_com(AT_SAPBR1,2000)!=0) return false;
  }
  // Инициализируем сервис HTTP 
  //          ATcom("AT+HTTPINIT","OK",500);
  AT_com(AT_HTTPINIT);
  // Задаём идентификатор профиля сеанса
  //      if (ATcom("AT+HTTPPARA=\"CID\",1","OK",500)!=0) return false;
  if (AT_com(AT_HTTPPARA)!=0) return false;
  // Задаём URL сайта, к которому будет отправляться запрос HTTP GET и готовим строку с URL-адресом, 
  // cобственно в URL заменяем обратные слэши на %22, иначе URL сбрасывается
  //ATcom("AT+HTTPPARA=\"URL\",\"http://probatv.ru/State/?cycle=7&num=5&ctrl=204&sjson={%22trkpt%22:{%22lat%22:52518611,%22lon%22:13376111,%22color%22:%22yellow%22}}\"","OK",2500);
  memset(response,'\0',170); 
  strcat(response,str0); 
  strcat(response,IntToChar(gcik)); 
  strcat(response,str1); 
  strcat(response,IntToChar(glat)); 
  strcat(response,str2); 
  strcat(response,IntToChar(glon)); 
  strcat(response,str3); 
  
  //Serial.print("sizeof(response)="); Serial.println(sizeof(response));
  Serial.println(response);  

  ATcom(response,"OK",2500);

  // Вводим команду для выполнения запроса GET: AT+HTTPACTION=0.
  // Параметр команды AT+HTTPACTION задает тип запроса HTTP: 0 — GET, 1 — POST, 2 — HEAD, 3 — DELETE.
  // В нашем случае нулевое значение предписывает выполнить запрос GET.
  // +HTTPACTION: 0,200,134
  //             ATcom("AT+HTTPACTION=0","OK",500);
  AT_com(AT_HTTPACTION0);

  // Ждем 5 сек для получения ответа
  saymess(m1_Wait5sek);
  delay(5000); 
  
  // Cчитываем результаты запроса, обычно содержит код состояния 200 в случае успеха
  //          ATcom("AT+HTTPREAD","OK",2500);
  AT_com(AT_HTTPREAD,2500);
  // Отключаем сервис HTTP
  //          ATcom("AT+HTTPTERM","OK",500);
  AT_com(AT_HTTPTERM);
  // Закрываем все соединения TCP/UDP, которые могли быть открыты на модуле. 
  // Использование этой команды может быть полезно, например, при переустановке 
  // соединения или для освобождения ресурсов, занятых предыдущими соединениями. 
  // if (ATcom("AT+CIPSHUT","OK",500)!=0) return false;
  // Закрываем носитель контекста GPRS (сессию), если он был оставлен открытым
  // (команда AT+SAPBR=0,1 используется для закрытия сессии и соединения TCP/IP, 
  // чтобы не расходовать ресурсы мобильного провайдера. 
  //if (ATcom("AT+SAPBR=0,1","OK",500)!=0) return false;
  if (AT_com(AT_SAPBR0)!=0) return false;
  return true;
}

#endif

// *************************************************************** SIM900.h ***

